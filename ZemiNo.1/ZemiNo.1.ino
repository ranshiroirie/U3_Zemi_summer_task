#define LIGHT 10
#define PIN 3

int val[10][14] = {
  {0, 0, 0, 0, 0, 0, 1, 1, 0, 0, 0, 0, 0, 0},
  {0, 0, 0, 0, 0, 1, 0, 0, 1, 0, 0, 0, 0, 0},
  {0, 0, 0, 0, 1, 0, 0, 0, 0, 1, 0, 0, 0, 0},
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  {0, 0, 0, 0, 0, 0, 1, 1, 0, 0, 0, 0, 0, 0}
};

void setup() {
  for (int i = 0; i < LIGHT; i++) {
    pinMode(PIN + i, OUTPUT);
  }
}

void loop() {
  for (int i = 0; i < 14; i++) {
    for (int j = 0; j < 10; j++) {
      if (val[i][j] == 1) {
        digitalWrite(PIN + j, HIGH);
      } else {
        digitalWrite(PIN + j, LOW);
      }
    }
    delay(5);
  }
}

